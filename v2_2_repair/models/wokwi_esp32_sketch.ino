// ============================================================================
// CUBESAT V2.2 STAGE-2 EXTREME-OPTIMIZED 9-LAYER TCN ENGINE (W8A32 INT8)
// Stage-2 Optimizations over Stage-1 (1233.6 ms):
//   1. 4-OC x 2-T Hardware FPU Register Tiling (8 accumulators in f0..f7,
//      2 inputs in f8..f9, 4 weights in f10..f13 -> ZERO RAM writes inside loop!)
//   2. Fully Unrolled K=5 and K=3 Dilated Inner Loops (40 MACs / 24 MACs per branch)
//   3. IRAM_ATTR + __attribute__((optimize("O3"), hot)) Zero-Wait-State Code Execution
//   4. 2.5 KB Per-Tile Transposed Weight Scratch Buffer (w_tile[4 * 32 * 5])
// ============================================================================
#pragma GCC optimize ("O3")
#include <Arduino.h>
#include <math.h>

#define L 128
#define NUM_SCENARIOS 4
#define SLIP_PROB_THRESHOLD 0.8200f

DRAM_ATTR const int8_t bb_0_w[360] = {58, 64, -30, 61, -32, 0, -54, 28, 59, -36, 102, 53, 127,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 -127, 106};

DRAM_ATTR const float bb_0_s[24] = {7.87865091e-03f, 4.51128697e-03f, 9.97297280e-03f, 2.16675978e-02f, 3.19658071e-02f, 1.81756951e-02f, 1.39336037e-02f, 5.35763521e-03f, 1.01674385e-02f, 6.77083526e-03f, 4.01923172e-02f, 5.79001978e-02f, 7.19452603e-03f, 3.46141085e-02f, 2.72520389e-02f, 4.23528999e-03f, 9.12029389e-03f, 2.39298735e-02f, 5.97760966e-03f, 5.86748449e-03f, 3.72819565e-02f, 4.51906445e-03f, 1.07240146e-02f, 1.10532222e-02f};

DRAM_ATTR const float bb_0_b[24] = {-1.08504105e+00f, 5.95331907e-01f, -1.24177849e+00f, 1.00923622e+00f, -7.26146877e-01f, 2.04395473e-01f, -3.46905589e-02f, 2.22581339e+00f, 7.02713668e-01f, 1.94353890e+00f, 2.63754606e-01f, -2.58972347e-01f, -2.04551554e+00f, 2.06040114e-01f, -1.15411647e-01f, -1.57389498e+00f, 1.45784974e+00f, 3.80679011e-01f, -4.37574387e-01f, 1.43707335e+00f, 7.64801741e-01f, -1.40837550e+00f, 1.84813261e-01f, -5.00454605e-02f};

DRAM_ATTR const int8_t bb_1_w[3840] = {0, -2, -32, 21, 28, 8, -22, -12, 16, 17, -4, -29, -24,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 4, -14};

DRAM_ATTR const float bb_1_s[32] = {2.70552351e-03f, 1.89095049e-03f, 2.23738211e-03f, 2.59995623e-03f, 4.05101851e-03f, 3.28106782e-03f, 2.22601113e-03f, 1.57909398e-03f, 2.35706032e-03f, 2.61419080e-03f, 1.93189643e-03f, 2.72423727e-03f, 2.37768330e-03f, 3.48359975e-03f, 2.49645161e-03f, 2.41853995e-03f, 2.06851703e-03f, 2.80231959e-03f, 2.28933385e-03f, 2.13624490e-03f, 2.42061447e-03f, 3.19771748e-03f, 2.66330945e-03f, 1.79214356e-03f, 2.90159765e-03f, 4.83348826e-03f, 3.11409496e-03f, 4.46465099e-03f, 2.99575180e-03f, 2.56160018e-03f, 1.62227370e-03f, 3.39442119e-03f};

DRAM_ATTR const float bb_1_b[32] = {-2.05642626e-01f, 1.46480775e+00f, 4.20324445e-01f, 2.54486084e-01f, -3.70855540e-01f, 9.38431680e-01f, -8.67877364e-01f, -1.56072527e-02f, 2.02495742e+00f, -2.48156965e-01f, -9.26980078e-01f, -1.58855224e+00f, -1.23008037e+00f, 1.67317796e+00f, -1.81434631e+00f, 1.47237968e+00f, 1.45902884e+00f, -1.78505719e+00f, -3.06549758e-01f, -1.35937238e+00f, 2.25005341e+00f, 5.38851202e-01f, 2.69503832e-01f, -1.04522514e+00f, 9.61375833e-01f, 1.03673369e-01f, 5.34911871e-01f, 6.00421965e-01f, -6.20427728e-02f, -3.17047209e-01f, -1.29465318e+00f, 6.25089169e-01f};

DRAM_ATTR const int8_t bb_2_w[5120] = {96, 64, 74, 50, 26, -20, -5, 37, -32, 15, -69, 1, -22,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 1, -29};

DRAM_ATTR const float bb_2_s[32] = {1.95294362e-03f, 1.35102891e-03f, 1.74683623e-03f, 1.95929781e-03f, 1.31869270e-03f, 9.75170173e-04f, 1.28106459e-03f, 2.02085101e-03f, 1.61189679e-03f, 1.01509294e-03f, 3.58378328e-03f, 1.05035410e-03f, 1.62119046e-03f, 1.58431265e-03f, 1.03513128e-03f, 1.05872017e-03f, 1.28664915e-03f, 1.61358819e-03f, 3.86158912e-03f, 3.38453520e-03f, 1.54961122e-03f, 1.78633223e-03f, 2.06275075e-03f, 1.66131963e-03f, 4.65547526e-03f, 2.31241342e-03f, 1.47263624e-03f, 1.04000838e-03f, 9.02126951e-04f, 1.45681133e-03f, 2.24043918e-03f, 1.75974087e-03f};

DRAM_ATTR const float bb_2_b[32] = {-1.12725782e+00f, 8.37612689e-01f, 9.09128249e-01f, -1.90200901e+00f, 3.92822862e-01f, 4.95480806e-01f, 3.89899850e-01f, 6.41546130e-01f, 1.05608448e-01f, 9.64474797e-01f, 1.81876004e+00f, 1.58050403e-01f, 1.01586509e+00f, 8.33885372e-01f, 3.76287580e-01f, -1.46784335e-01f, 2.26556838e-01f, 9.49725449e-01f, 2.55401522e-01f, -2.27143168e+00f, 1.35547072e-01f, -3.11210060e+00f, 1.06240749e+00f, -1.31595224e-01f, -4.74907309e-01f, -1.12745929e+00f, -3.59892845e-01f, 1.53587282e-01f, 3.33972424e-01f, -2.70292616e+00f, -4.61993068e-01f, -3.56241494e-01f};

DRAM_ATTR const int8_t bb_3_w[3072] = {9, -19, -40, 11, 11, -37, -12, 26, 37, 2, -71, -11, -26,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 64, 41};

DRAM_ATTR const float bb_3_s[32] = {1.55854074e-03f, 1.61625864e-03f, 1.36222318e-03f, 2.64770398e-03f, 1.81244395e-03f, 1.42291456e-03f, 2.68036290e-03f, 1.31583516e-03f, 1.76022761e-03f, 2.97748647e-03f, 1.42688642e-03f, 2.23784335e-03f, 2.50344584e-03f, 1.80898677e-03f, 2.27757916e-03f, 4.84722294e-03f, 2.47996417e-03f, 3.36445472e-03f, 5.91358077e-03f, 1.06571242e-03f, 3.57520604e-03f, 2.40175892e-03f, 1.37027458e-03f, 2.12493259e-03f, 1.61363988e-03f, 3.51136969e-03f, 5.12697082e-03f, 2.05331552e-03f, 1.34362699e-03f, 1.40103174e-03f, 2.55864463e-03f, 3.53916455e-03f};

DRAM_ATTR const float bb_3_b[32] = {4.60376978e-01f, 3.05713117e-01f, 4.61475968e-01f, 1.29399598e+00f, -1.30442727e+00f, 2.03856796e-01f, 7.76770890e-01f, -9.32069540e-01f, 9.26302969e-01f, 4.93531525e-01f, 7.15209067e-01f, 1.35447234e-01f, 1.49116349e+00f, 1.49765885e+00f, 1.15945947e+00f, -2.34061182e-01f, 5.15094638e-01f, -7.51597211e-02f, -4.13384020e-01f, -8.35380256e-02f, -9.96626392e-02f, 9.94751081e-02f, 1.09394562e+00f, 9.20112312e-01f, 9.51628089e-01f, -2.69486338e-01f, -1.73641741e-01f, 5.24467230e-01f, 6.19158089e-01f, 3.47947061e-01f, 1.06384504e+00f, -7.33509004e-01f};

DRAM_ATTR const int8_t env_0_w[32] = {56, 124, 120, 9, -37, 77, -7, -85, 71, -16, 118, 4, -35, 56, 20, 1, 35, -6, 4, -56, -4, -1, 127, 2, 48, 8, 12, 79, 75, 88, 60, -14};

DRAM_ATTR const float env_0_s[1] = {1.42604229e-03f};

DRAM_ATTR const float env_0_b[1] = {2.96833783e-01f};

DRAM_ATTR const int8_t slip_0_w[1536] = {3, -19, -3, 3, -23, 6, 3, -4, -6, -34, -16, -11, 10,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 -71, -21};

DRAM_ATTR const float slip_0_s[16] = {8.25318974e-03f, 5.31755947e-03f, 5.54557424e-03f, 3.47445835e-03f, 4.47330950e-03f, 5.66632813e-03f, 5.41879889e-03f, 3.62788583e-03f, 1.04077079e-03f, 3.18995398e-03f, 1.02178939e-03f, 8.78476445e-03f, 1.02195248e-03f, 4.64399345e-03f, 2.96091405e-03f, 7.53307808e-03f};

DRAM_ATTR const float slip_0_b[16] = {-9.52190235e-02f, -1.08452238e-01f, -6.27557263e-02f, -9.19305235e-02f, 2.10650504e-01f, -1.99002642e-02f, 3.10900986e-01f, 2.34902531e-01f, -1.22543372e-01f, -1.46662474e-01f, -8.11187327e-02f, 4.41909535e-03f, 5.95289581e-02f, -1.12403482e-01f, 1.84476167e-01f, 2.86259443e-01f};

DRAM_ATTR const int8_t slip_2_w[16] = {92, 73, 53, 70, -79, 125, -68, -127, 21, 68, 34, 72, 12, 68, -80, -79};

DRAM_ATTR const float slip_2_s[1] = {4.52315761e-03f};

DRAM_ATTR const float slip_2_b[1] = {-1.19522475e-01f};

DRAM_ATTR const int8_t s4_0_w[1536] = {-77, -67, -68, -37, -95, 34, -20, 62, -90, 10, -54, 37, -61,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 23, 25};

DRAM_ATTR const float s4_0_s[16] = {9.32914321e-04f, 9.59065568e-04f, 1.61395746e-03f, 9.32966126e-04f, 1.86655833e-03f, 9.05240478e-04f, 8.62854184e-04f, 1.95080962e-03f, 8.90398223e-04f, 2.01513665e-03f, 9.35249147e-04f, 2.00869865e-03f, 1.09004986e-03f, 9.08278045e-04f, 2.78382283e-03f, 1.83015852e-03f};

DRAM_ATTR const float s4_0_b[16] = {-5.56251928e-02f, 7.51504898e-02f, 5.47133312e-02f, -8.92904103e-02f, -6.62600249e-02f, 5.07046245e-02f, -8.15607328e-03f, 4.87251468e-02f, -5.01555689e-02f, 8.97579342e-02f, -5.72475120e-02f, -2.04862915e-02f, 5.24618141e-02f, -6.10583052e-02f, 2.20211297e-02f, -3.18758376e-02f};

DRAM_ATTR const int8_t s4_2_w[16] = {-21, -71, 4, -5, 7, -107, -125, 127, -101, 56, -121, 38, 7, -64, 35, 25};

DRAM_ATTR const float s4_2_s[1] = {1.65994221e-03f};

DRAM_ATTR const float s4_2_b[1] = {7.75328726e-02f};

const float test_scenarios_x[1536] = {6.95308268e-01f, 6.91647232e-01f, 5.25920868e-01f, 7.79226005e-01f, 6.42872155e-01f, 5.85798025e-01f, 6.21464252e-01f, 6.94355190e-01f, 8.22653592e-01f, 7.61166036e-01f, 8.40246677e-01f, 8.89620483e-01f, 8.72206509e-01f,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 -3.89741629e-01f, -3.58376116e-01f};

const float py_ref_outputs[1536] = {8.46218467e-01f, 8.35704684e-01f, 8.58890474e-01f, 8.52886081e-01f, 8.28226388e-01f, 8.18685532e-01f, 8.41508627e-01f, 8.54815960e-01f, 8.13301682e-01f, 8.16705465e-01f, 8.05788517e-01f, 8.28962505e-01f, 8.04009378e-01f,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 6.27105594e-01f, 6.27591193e-01f};

const char* const SCENARIO_NAMES[4] = {"Case0_Benchmark_Ref", "Case1_Quiet_Normal", "Case2_Severe_Scint_Noisy", "Case3_Multi_Cycle_Slip"};


// Static Working SRAM Buffers:
// bufA (32*128*4 = 16,384 B) + bufB (16,384 B) + w_tile (4*32*5*4 = 2,560 B) + outputs (1,536 B) + stats (256 B)
// Total Buffers = 37,120 B (36.25 KB) + Weights/Scales (16,768 B) = 53,888 B (10.1% of 520 KB ESP32 SRAM)
DRAM_ATTR static float bufA[32 * L];
DRAM_ATTR static float bufB[32 * L];
DRAM_ATTR static float w_tile[32 * 5 * 4];
DRAM_ATTR static float feat_mean[32];
DRAM_ATTR static float feat_std[32];

DRAM_ATTR static float out_env[L];
DRAM_ATTR static float out_slip_logits[L];
DRAM_ATTR static float out_s4[L];

struct LayerProfile {
    unsigned long bb0_us, bb1_us, bb2_us, bb3_us;
    unsigned long env0_us, slip0_us, slip2_us;
    unsigned long s4_pool_us, s4_0_us, s4_2_us;
    unsigned long total_us;
};

// ============================================================================
// STAGE-2 KERNEL 1: 4-OC x 2-T REGISTER-TILED & UNROLLED K=5 DILATED CONV1D
// Used by: bb_0 (d=1, pad=2), bb_1 (d=2, pad=4), bb_2 (d=4, pad=8)
// ============================================================================
void IRAM_ATTR __attribute__((optimize("O3"), hot)) conv1d_k5_register_tiled(
    const float* __restrict__ in,
    float* __restrict__ out,
    const int8_t* __restrict__ w,
    const float* __restrict__ s_per_ch,
    const float* __restrict__ b_per_ch,
    int in_c, int out_c, int d, int pad
) {
    const int d2 = d * 2;
    const int t_int_start = pad;
    const int t_int_end = L - pad; // Exclusive bound for safe interior steps

    for (int oc = 0; oc < out_c; oc += 4) {
        const float s0 = s_per_ch[oc + 0], s1 = s_per_ch[oc + 1];
        const float s2 = s_per_ch[oc + 2], s3 = s_per_ch[oc + 3];
        const float b0 = b_per_ch[oc + 0], b1 = b_per_ch[oc + 1];
        const float b2 = b_per_ch[oc + 2], b3 = b_per_ch[oc + 3];

        const int stride_oc = in_c * 5;
        const int8_t* __restrict__ w0_src = w + (oc + 0) * stride_oc;
        const int8_t* __restrict__ w1_src = w + (oc + 1) * stride_oc;
        const int8_t* __restrict__ w2_src = w + (oc + 2) * stride_oc;
        const int8_t* __restrict__ w3_src = w + (oc + 3) * stride_oc;

        // Dequantize & transpose 4 output channels into contiguous [ic][ki][4] tile
        float* __restrict__ wt = w_tile;
        for (int idx = 0; idx < stride_oc; idx++) {
            wt[0] = (float)w0_src[idx] * s0;
            wt[1] = (float)w1_src[idx] * s1;
            wt[2] = (float)w2_src[idx] * s2;
            wt[3] = (float)w3_src[idx] * s3;
            wt += 4;
        }

        float* __restrict__ out0 = out + (oc + 0) * L;
        float* __restrict__ out1 = out + (oc + 1) * L;
        float* __restrict__ out2 = out + (oc + 2) * L;
        float* __restrict__ out3 = out + (oc + 3) * L;

        // 1. Left & Right Boundary Timesteps (exact branch-checked fallback)
        for (int side = 0; side < 2; side++) {
            const int tb_start = (side == 0) ? 0 : t_int_end;
            const int tb_end   = (side == 0) ? t_int_start : L;
            for (int t = tb_start; t < tb_end; t++) {
                float a0 = b0, a1 = b1, a2 = b2, a3 = b3;
                const float* __restrict__ w_ptr = w_tile;
                for (int ic = 0; ic < in_c; ic++) {
                    const float* __restrict__ in_ic = in + ic * L;
                    for (int ki = 0; ki < 5; ki++) {
                        const int t_in = t - pad + ki * d;
                        if (t_in >= 0 && t_in < L) {
                            const float x = in_ic[t_in];
                            a0 += x * w_ptr[0];
                            a1 += x * w_ptr[1];
                            a2 += x * w_ptr[2];
                            a3 += x * w_ptr[3];
                        }
                        w_ptr += 4;
                    }
                }
                out0[t] = (a0 > 0.0f) ? a0 : 0.0f;
                out1[t] = (a1 > 0.0f) ? a1 : 0.0f;
                out2[t] = (a2 > 0.0f) ? a2 : 0.0f;
                out3[t] = (a3 > 0.0f) ? a3 : 0.0f;
            }
        }

        // 2. Fast Interior Timesteps: 4-OC x 2-T FPU Register Tile (40 MACs per ic iteration, 0 branches!)
        for (int t = t_int_start; t < t_int_end; t += 2) {
            float a00 = b0, a01 = b0;
            float a10 = b1, a11 = b1;
            float a20 = b2, a21 = b2;
            float a30 = b3, a31 = b3;

            const float* __restrict__ w_ptr = w_tile;
            const float* __restrict__ in_ptr = in + t;

            for (int ic = 0; ic < in_c; ic++) {
                float x0, x1;
                // Tap 0 (offset = -d2)
                x0 = in_ptr[-d2]; x1 = in_ptr[-d2 + 1];
                a00 += x0 * w_ptr[0]; a01 += x1 * w_ptr[0];
                a10 += x0 * w_ptr[1]; a11 += x1 * w_ptr[1];
                a20 += x0 * w_ptr[2]; a21 += x1 * w_ptr[2];
                a30 += x0 * w_ptr[3]; a31 += x1 * w_ptr[3];

                // Tap 1 (offset = -d)
                x0 = in_ptr[-d]; x1 = in_ptr[-d + 1];
                a00 += x0 * w_ptr[4]; a01 += x1 * w_ptr[4];
                a10 += x0 * w_ptr[5]; a11 += x1 * w_ptr[5];
                a20 += x0 * w_ptr[6]; a21 += x1 * w_ptr[6];
                a30 += x0 * w_ptr[7]; a31 += x1 * w_ptr[7];

                // Tap 2 (offset = 0)
                x0 = in_ptr[0]; x1 = in_ptr[1];
                a00 += x0 * w_ptr[8];  a01 += x1 * w_ptr[8];
                a10 += x0 * w_ptr[9];  a11 += x1 * w_ptr[9];
                a20 += x0 * w_ptr[10]; a21 += x1 * w_ptr[10];
                a30 += x0 * w_ptr[11]; a31 += x1 * w_ptr[11];

                // Tap 3 (offset = +d)
                x0 = in_ptr[d]; x1 = in_ptr[d + 1];
                a00 += x0 * w_ptr[12]; a01 += x1 * w_ptr[12];
                a10 += x0 * w_ptr[13]; a11 += x1 * w_ptr[13];
                a20 += x0 * w_ptr[14]; a21 += x1 * w_ptr[14];
                a30 += x0 * w_ptr[15]; a31 += x1 * w_ptr[15];

                // Tap 4 (offset = +d2)
                x0 = in_ptr[d2]; x1 = in_ptr[d2 + 1];
                a00 += x0 * w_ptr[16]; a01 += x1 * w_ptr[16];
                a10 += x0 * w_ptr[17]; a11 += x1 * w_ptr[17];
                a20 += x0 * w_ptr[18]; a21 += x1 * w_ptr[18];
                a30 += x0 * w_ptr[19]; a31 += x1 * w_ptr[19];

                w_ptr += 20;
                in_ptr += L;
            }

            out0[t] = (a00 > 0.0f) ? a00 : 0.0f; out0[t + 1] = (a01 > 0.0f) ? a01 : 0.0f;
            out1[t] = (a10 > 0.0f) ? a10 : 0.0f; out1[t + 1] = (a11 > 0.0f) ? a11 : 0.0f;
            out2[t] = (a20 > 0.0f) ? a20 : 0.0f; out2[t + 1] = (a21 > 0.0f) ? a21 : 0.0f;
            out3[t] = (a30 > 0.0f) ? a30 : 0.0f; out3[t + 1] = (a31 > 0.0f) ? a31 : 0.0f;
        }
    }
}

// ============================================================================
// STAGE-2 KERNEL 2: 4-OC x 2-T REGISTER-TILED & UNROLLED K=3 DILATED CONV1D
// Used by: bb_3 (32->32, k=3, d=8, pad=8), slip_0 (32->16, k=3, d=1, pad=1)
// ============================================================================
void IRAM_ATTR __attribute__((optimize("O3"), hot)) conv1d_k3_register_tiled(
    const float* __restrict__ in,
    float* __restrict__ out,
    const int8_t* __restrict__ w,
    const float* __restrict__ s_per_ch,
    const float* __restrict__ b_per_ch,
    int in_c, int out_c, int d, int pad
) {
    const int t_int_start = pad;
    const int t_int_end = L - pad;
    const int interior_len = t_int_end - t_int_start;
    const int t_vec_end = t_int_start + (interior_len & ~1);

    for (int oc = 0; oc < out_c; oc += 4) {
        const float s0 = s_per_ch[oc + 0], s1 = s_per_ch[oc + 1];
        const float s2 = s_per_ch[oc + 2], s3 = s_per_ch[oc + 3];
        const float b0 = b_per_ch[oc + 0], b1 = b_per_ch[oc + 1];
        const float b2 = b_per_ch[oc + 2], b3 = b_per_ch[oc + 3];

        const int stride_oc = in_c * 3;
        const int8_t* __restrict__ w0_src = w + (oc + 0) * stride_oc;
        const int8_t* __restrict__ w1_src = w + (oc + 1) * stride_oc;
        const int8_t* __restrict__ w2_src = w + (oc + 2) * stride_oc;
        const int8_t* __restrict__ w3_src = w + (oc + 3) * stride_oc;

        float* __restrict__ wt = w_tile;
        for (int idx = 0; idx < stride_oc; idx++) {
            wt[0] = (float)w0_src[idx] * s0;
            wt[1] = (float)w1_src[idx] * s1;
            wt[2] = (float)w2_src[idx] * s2;
            wt[3] = (float)w3_src[idx] * s3;
            wt += 4;
        }

        float* __restrict__ out0 = out + (oc + 0) * L;
        float* __restrict__ out1 = out + (oc + 1) * L;
        float* __restrict__ out2 = out + (oc + 2) * L;
        float* __restrict__ out3 = out + (oc + 3) * L;

        // 1. Boundary Timesteps
        for (int side = 0; side < 2; side++) {
            const int tb_start = (side == 0) ? 0 : t_vec_end;
            const int tb_end   = (side == 0) ? t_int_start : L;
            for (int t = tb_start; t < tb_end; t++) {
                float a0 = b0, a1 = b1, a2 = b2, a3 = b3;
                const float* __restrict__ w_ptr = w_tile;
                for (int ic = 0; ic < in_c; ic++) {
                    const float* __restrict__ in_ic = in + ic * L;
                    for (int ki = 0; ki < 3; ki++) {
                        const int t_in = t - pad + ki * d;
                        if (t_in >= 0 && t_in < L) {
                            const float x = in_ic[t_in];
                            a0 += x * w_ptr[0];
                            a1 += x * w_ptr[1];
                            a2 += x * w_ptr[2];
                            a3 += x * w_ptr[3];
                        }
                        w_ptr += 4;
                    }
                }
                out0[t] = (a0 > 0.0f) ? a0 : 0.0f;
                out1[t] = (a1 > 0.0f) ? a1 : 0.0f;
                out2[t] = (a2 > 0.0f) ? a2 : 0.0f;
                out3[t] = (a3 > 0.0f) ? a3 : 0.0f;
            }
        }

        // 2. Fast Interior Timesteps: 4-OC x 2-T FPU Register Tile (24 MACs per ic iteration, 0 branches!)
        for (int t = t_int_start; t < t_vec_end; t += 2) {
            float a00 = b0, a01 = b0;
            float a10 = b1, a11 = b1;
            float a20 = b2, a21 = b2;
            float a30 = b3, a31 = b3;

            const float* __restrict__ w_ptr = w_tile;
            const float* __restrict__ in_ptr = in + t;

            for (int ic = 0; ic < in_c; ic++) {
                float x0, x1;
                // Tap 0 (offset = -d)
                x0 = in_ptr[-d]; x1 = in_ptr[-d + 1];
                a00 += x0 * w_ptr[0]; a01 += x1 * w_ptr[0];
                a10 += x0 * w_ptr[1]; a11 += x1 * w_ptr[1];
                a20 += x0 * w_ptr[2]; a21 += x1 * w_ptr[2];
                a30 += x0 * w_ptr[3]; a31 += x1 * w_ptr[3];

                // Tap 1 (offset = 0)
                x0 = in_ptr[0]; x1 = in_ptr[1];
                a00 += x0 * w_ptr[4]; a01 += x1 * w_ptr[4];
                a10 += x0 * w_ptr[5]; a11 += x1 * w_ptr[5];
                a20 += x0 * w_ptr[6]; a21 += x1 * w_ptr[6];
                a30 += x0 * w_ptr[7]; a31 += x1 * w_ptr[7];

                // Tap 2 (offset = +d)
                x0 = in_ptr[d]; x1 = in_ptr[d + 1];
                a00 += x0 * w_ptr[8];  a01 += x1 * w_ptr[8];
                a10 += x0 * w_ptr[9];  a11 += x1 * w_ptr[9];
                a20 += x0 * w_ptr[10]; a21 += x1 * w_ptr[10];
                a30 += x0 * w_ptr[11]; a31 += x1 * w_ptr[11];

                w_ptr += 12;
                in_ptr += L;
            }

            out0[t] = (a00 > 0.0f) ? a00 : 0.0f; out0[t + 1] = (a01 > 0.0f) ? a01 : 0.0f;
            out1[t] = (a10 > 0.0f) ? a10 : 0.0f; out1[t + 1] = (a11 > 0.0f) ? a11 : 0.0f;
            out2[t] = (a20 > 0.0f) ? a20 : 0.0f; out2[t + 1] = (a21 > 0.0f) ? a21 : 0.0f;
            out3[t] = (a30 > 0.0f) ? a30 : 0.0f; out3[t + 1] = (a31 > 0.0f) ? a31 : 0.0f;
        }
    }
}

// ============================================================================
// STAGE-2 KERNEL 3: 1-OC x 4-T REGISTER-TILED POINTWISE K=1 PROJECTION
// Used by: env_0 (32->1), slip_2 (16->1), s4_2 (16->1)
// ============================================================================
void IRAM_ATTR __attribute__((optimize("O3"), hot)) conv1d_k1_1oc_register_tiled(
    const float* __restrict__ in,
    float* __restrict__ out,
    const int8_t* __restrict__ w,
    const float* __restrict__ s_per_ch,
    const float* __restrict__ b_per_ch,
    int in_c
) {
    const float w_scale = s_per_ch[0];
    const float bias = b_per_ch[0];
    for (int ic = 0; ic < in_c; ic++) {
        w_tile[ic] = (float)w[ic] * w_scale;
    }
    for (int t = 0; t < L; t += 4) {
        float a0 = bias, a1 = bias, a2 = bias, a3 = bias;
        const float* __restrict__ in_ptr = in + t;
        for (int ic = 0; ic < in_c; ic++) {
            const float w_val = w_tile[ic];
            a0 += in_ptr[0] * w_val;
            a1 += in_ptr[1] * w_val;
            a2 += in_ptr[2] * w_val;
            a3 += in_ptr[3] * w_val;
            in_ptr += L;
        }
        out[t + 0] = a0;
        out[t + 1] = a1;
        out[t + 2] = a2;
        out[t + 3] = a3;
    }
}

// ============================================================================
// STAGE-2 KERNEL 4: GLOBAL POOLING + 4-OC x 2-T REGISTER-TILED S4_0 (96->16)
// ============================================================================
void IRAM_ATTR __attribute__((optimize("O3"), hot)) compute_s4_pool_opt(const float* __restrict__ feats) {
    const float inv_L = 1.0f / (float)L;
    for (int c = 0; c < 32; c++) {
        const float* __restrict__ f_c = feats + c * L;
        float s0 = 0.0f, s1 = 0.0f;
        for (int t = 0; t < L; t += 2) {
            s0 += f_c[t];
            s1 += f_c[t + 1];
        }
        const float mean = (s0 + s1) * inv_L;
        float v0 = 0.0f, v1 = 0.0f;
        for (int t = 0; t < L; t += 2) {
            const float d0 = f_c[t] - mean;
            const float d1 = f_c[t + 1] - mean;
            v0 += d0 * d0;
            v1 += d1 * d1;
        }
        feat_mean[c] = mean;
        feat_std[c] = sqrtf((v0 + v1) * inv_L);
    }
}

void IRAM_ATTR __attribute__((optimize("O3"), hot)) compute_s4_0_register_tiled(
    const float* __restrict__ feats,
    float* __restrict__ s4_hidden
) {
    for (int oc = 0; oc < 16; oc += 4) {
        const float s0 = s4_0_s[oc + 0], s1 = s4_0_s[oc + 1];
        const float s2 = s4_0_s[oc + 2], s3 = s4_0_s[oc + 3];
        const int8_t* __restrict__ w0 = s4_0_w + (oc + 0) * 96;
        const int8_t* __restrict__ w1 = s4_0_w + (oc + 1) * 96;
        const int8_t* __restrict__ w2 = s4_0_w + (oc + 2) * 96;
        const int8_t* __restrict__ w3 = s4_0_w + (oc + 3) * 96;

        float cb0 = s4_0_b[oc + 0], cb1 = s4_0_b[oc + 1];
        float cb2 = s4_0_b[oc + 2], cb3 = s4_0_b[oc + 3];

        float* __restrict__ wt = w_tile;
        for (int c = 0; c < 32; c++) {
            const float m = feat_mean[c];
            const float sd = feat_std[c];
            cb0 += m * ((float)w0[32 + c] * s0) + sd * ((float)w0[64 + c] * s0);
            cb1 += m * ((float)w1[32 + c] * s1) + sd * ((float)w1[64 + c] * s1);
            cb2 += m * ((float)w2[32 + c] * s2) + sd * ((float)w2[64 + c] * s2);
            cb3 += m * ((float)w3[32 + c] * s3) + sd * ((float)w3[64 + c] * s3);

            wt[0] = (float)w0[c] * s0;
            wt[1] = (float)w1[c] * s1;
            wt[2] = (float)w2[c] * s2;
            wt[3] = (float)w3[c] * s3;
            wt += 4;
        }

        float* __restrict__ out0 = s4_hidden + (oc + 0) * L;
        float* __restrict__ out1 = s4_hidden + (oc + 1) * L;
        float* __restrict__ out2 = s4_hidden + (oc + 2) * L;
        float* __restrict__ out3 = s4_hidden + (oc + 3) * L;

        for (int t = 0; t < L; t += 2) {
            float a00 = cb0, a01 = cb0;
            float a10 = cb1, a11 = cb1;
            float a20 = cb2, a21 = cb2;
            float a30 = cb3, a31 = cb3;

            const float* __restrict__ w_ptr = w_tile;
            const float* __restrict__ f_ptr = feats + t;
            for (int c = 0; c < 32; c++) {
                const float x0 = f_ptr[0];
                const float x1 = f_ptr[1];
                a00 += x0 * w_ptr[0]; a01 += x1 * w_ptr[0];
                a10 += x0 * w_ptr[1]; a11 += x1 * w_ptr[1];
                a20 += x0 * w_ptr[2]; a21 += x1 * w_ptr[2];
                a30 += x0 * w_ptr[3]; a31 += x1 * w_ptr[3];
                w_ptr += 4;
                f_ptr += L;
            }
            out0[t] = (a00 > 0.0f) ? a00 : 0.0f; out0[t + 1] = (a01 > 0.0f) ? a01 : 0.0f;
            out1[t] = (a10 > 0.0f) ? a10 : 0.0f; out1[t + 1] = (a11 > 0.0f) ? a11 : 0.0f;
            out2[t] = (a20 > 0.0f) ? a20 : 0.0f; out2[t + 1] = (a21 > 0.0f) ? a21 : 0.0f;
            out3[t] = (a30 > 0.0f) ? a30 : 0.0f; out3[t + 1] = (a31 > 0.0f) ? a31 : 0.0f;
        }
    }
}

// Uninstrumented Fast Complete 9-Layer Forward Pass in IRAM
void IRAM_ATTR __attribute__((optimize("O3"), hot)) run_tcn_inference_stage2(const float* __restrict__ input_tensor) {
    conv1d_k5_register_tiled(input_tensor, bufA, bb_0_w, bb_0_s, bb_0_b, 3, 24, 1, 2);
    conv1d_k5_register_tiled(bufA, bufB, bb_1_w, bb_1_s, bb_1_b, 24, 32, 2, 4);
    conv1d_k5_register_tiled(bufB, bufA, bb_2_w, bb_2_s, bb_2_b, 32, 32, 4, 8);
    conv1d_k3_register_tiled(bufA, bufB, bb_3_w, bb_3_s, bb_3_b, 32, 32, 8, 8);

    conv1d_k1_1oc_register_tiled(bufB, out_env, env_0_w, env_0_s, env_0_b, 32);

    conv1d_k3_register_tiled(bufB, bufA, slip_0_w, slip_0_s, slip_0_b, 32, 16, 1, 1);
    conv1d_k1_1oc_register_tiled(bufA, out_slip_logits, slip_2_w, slip_2_s, slip_2_b, 16);

    compute_s4_pool_opt(bufB);
    compute_s4_0_register_tiled(bufB, bufA);
    conv1d_k1_1oc_register_tiled(bufA, out_s4, s4_2_w, s4_2_s, s4_2_b, 16);
}

void run_stage2_profiled(const float* __restrict__ input_tensor, LayerProfile& prof) {
    unsigned long t0 = micros(), t1;
    conv1d_k5_register_tiled(input_tensor, bufA, bb_0_w, bb_0_s, bb_0_b, 3, 24, 1, 2);
    t1 = micros(); prof.bb0_us = t1 - t0; t0 = t1;

    conv1d_k5_register_tiled(bufA, bufB, bb_1_w, bb_1_s, bb_1_b, 24, 32, 2, 4);
    t1 = micros(); prof.bb1_us = t1 - t0; t0 = t1;

    conv1d_k5_register_tiled(bufB, bufA, bb_2_w, bb_2_s, bb_2_b, 32, 32, 4, 8);
    t1 = micros(); prof.bb2_us = t1 - t0; t0 = t1;

    conv1d_k3_register_tiled(bufA, bufB, bb_3_w, bb_3_s, bb_3_b, 32, 32, 8, 8);
    t1 = micros(); prof.bb3_us = t1 - t0; t0 = t1;

    conv1d_k1_1oc_register_tiled(bufB, out_env, env_0_w, env_0_s, env_0_b, 32);
    t1 = micros(); prof.env0_us = t1 - t0; t0 = t1;

    conv1d_k3_register_tiled(bufB, bufA, slip_0_w, slip_0_s, slip_0_b, 32, 16, 1, 1);
    t1 = micros(); prof.slip0_us = t1 - t0; t0 = t1;

    conv1d_k1_1oc_register_tiled(bufA, out_slip_logits, slip_2_w, slip_2_s, slip_2_b, 16);
    t1 = micros(); prof.slip2_us = t1 - t0; t0 = t1;

    compute_s4_pool_opt(bufB);
    t1 = micros(); prof.s4_pool_us = t1 - t0; t0 = t1;

    compute_s4_0_register_tiled(bufB, bufA);
    t1 = micros(); prof.s4_0_us = t1 - t0; t0 = t1;

    conv1d_k1_1oc_register_tiled(bufA, out_s4, s4_2_w, s4_2_s, s4_2_b, 16);
    t1 = micros(); prof.s4_2_us = t1 - t0;
    prof.total_us = prof.bb0_us + prof.bb1_us + prof.bb2_us + prof.bb3_us +
                    prof.env0_us + prof.slip0_us + prof.slip2_us +
                    prof.s4_pool_us + prof.s4_0_us + prof.s4_2_us;
}

void setup() {
    Serial.begin(115200);
    delay(1000);
    Serial.println("==========================================================================");
    Serial.println("CUBESAT V2.2 STAGE-2 REGISTER-TILED & IRAM UNROLLED 9-LAYER TCN (L=128)");
    Serial.println("Note: Wokwi timing reflects simulated Xtensa LX6 execution, not silicon.");
    Serial.println("==========================================================================");

    LayerProfile prof_s2;
    run_stage2_profiled(test_scenarios_x, prof_s2);

    Serial.println("\n--- [STAGE-2] REGISTER-TILED + IRAM PER-LAYER PROFILE (SCENARIO 0) ---");
    Serial.printf("  bb_0 (3->24, k=5, d=1):   %8lu us (Legacy:  101963 us | Stage-1:   33938 us)\n", prof_s2.bb0_us);
    Serial.printf("  bb_1 (24->32, k=5, d=2):  %8lu us (Legacy: 1041628 us | Stage-1:  331506 us)\n", prof_s2.bb1_us);
    Serial.printf("  bb_2 (32->32, k=5, d=4):  %8lu us (Legacy: 1374783 us | Stage-1:  433558 us)\n", prof_s2.bb2_us);
    Serial.printf("  bb_3 (32->32, k=3, d=8):  %8lu us (Legacy:  894653 us | Stage-1:  260505 us)\n", prof_s2.bb3_us);
    Serial.printf("  Head1 env_0 (32->1, k=1): %8lu us (Legacy:   13051 us | Stage-1:    1927 us)\n", prof_s2.env0_us);
    Serial.printf("  Head2 slip_0 (32->16,k=3):%8lu us (Legacy:  454426 us | Stage-1:  134986 us)\n", prof_s2.slip0_us);
    Serial.printf("  Head2 slip_2 (16->1, k=1):%8lu us (Legacy:    6628 us | Stage-1:     940 us)\n", prof_s2.slip2_us);
    Serial.printf("  Head3 s4_pool (mean+std): %8lu us (Legacy:    7047 us | Stage-1:    3358 us)\n", prof_s2.s4_pool_us);
    Serial.printf("  Head3 s4_0 (96->16, k=1): %8lu us (Legacy:  627817 us | Stage-1:   32266 us)\n", prof_s2.s4_0_us);
    Serial.printf("  Head3 s4_2 (16->1, k=1):  %8lu us (Legacy:    6628 us | Stage-1:     940 us)\n", prof_s2.s4_2_us);
    Serial.printf("  STAGE-2 INSTRUMENTED SUM: %8lu us (%.3f ms)\n", prof_s2.total_us, prof_s2.total_us / 1000.0f);

    Serial.println("\n--- [PHASE 4] FULL-ARRAY NUMERICAL AUDIT ACROSS 4 TEST SCENARIOS ---");
    for (int s = 0; s < NUM_SCENARIOS; s++) {
        const float* x_in = test_scenarios_x + s * (3 * L);
        const float* py_ref = py_ref_outputs + s * (3 * L);
        const float* py_env = py_ref;
        const float* py_slip = py_ref + L;
        const float* py_s4 = py_ref + 2 * L;

        run_tcn_inference_stage2(x_in);

        float env_max_e = 0.0f, env_sum_e = 0.0f;
        float prob_max_e = 0.0f, prob_sum_e = 0.0f;
        float s4_max_e = 0.0f, s4_sum_e = 0.0f;
        float s4_mean = 0.0f;
        int opt_flags = 0, py_flags = 0, flag_mismatches = 0;
        bool finite_ok = true;

        for (int t = 0; t < L; t++) {
            if (!isfinite(out_env[t]) || !isfinite(out_slip_logits[t]) || !isfinite(out_s4[t])) finite_ok = false;
            float ee = fabsf(out_env[t] - py_env[t]);
            if (ee > env_max_e) env_max_e = ee;
            env_sum_e += ee;

            float c_log = constrain(out_slip_logits[t], -20.0f, 20.0f);
            float p_log = constrain(py_slip[t], -20.0f, 20.0f);
            float c_prob = 1.0f / (1.0f + expf(-c_log));
            float p_prob = 1.0f / (1.0f + expf(-p_log));
            float pe = fabsf(c_prob - p_prob);
            if (pe > prob_max_e) prob_max_e = pe;
            prob_sum_e += pe;

            int cf = (c_prob >= SLIP_PROB_THRESHOLD) ? 1 : 0;
            int pf = (p_prob >= SLIP_PROB_THRESHOLD) ? 1 : 0;
            opt_flags += cf;
            py_flags += pf;
            if (cf != pf) flag_mismatches++;

            float se = fabsf(out_s4[t] - py_s4[t]);
            if (se > s4_max_e) s4_max_e = se;
            s4_sum_e += se;
            s4_mean += out_s4[t];
        }
        s4_mean /= (float)L;

        Serial.printf("[%s] Finite=%s | S4 Mean=%.4f | Env[64]=%.4f | Flags=%d/%d (Mismatch=%d)\n",
                      SCENARIO_NAMES[s], finite_ok ? "YES" : "NO", s4_mean, out_env[64], opt_flags, py_flags, flag_mismatches);
        Serial.printf("  Full-Array Err vs Python -> Env Max=%.2e (MAE=%.2e) | Prob Max=%.2e (MAE=%.2e) | S4 Max=%.2e (MAE=%.2e)\n",
                      env_max_e, env_sum_e / L, prob_max_e, prob_sum_e / L, s4_max_e, s4_sum_e / L);
    }

    Serial.println("\n--- [PHASE 5] UNINSTRUMENTED MULTI-ITERATION BENCHMARK (20 RUNS AFTER WARM-UP) ---");
    for (int w = 0; w < 3; w++) {
        run_tcn_inference_stage2(test_scenarios_x + (w % NUM_SCENARIOS) * (3 * L));
    }

    unsigned long times_us[20];
    uint32_t cycles_arr[20];
    for (int i = 0; i < 20; i++) {
        const float* x_in = test_scenarios_x + (i % NUM_SCENARIOS) * (3 * L);
        uint32_t c0 = ESP.getCycleCount();
        unsigned long t0 = micros();
        run_tcn_inference_stage2(x_in);
        unsigned long dt = micros() - t0;
        uint32_t dc = ESP.getCycleCount() - c0;
        times_us[i] = dt;
        cycles_arr[i] = dc;
    }

    for (int i = 0; i < 19; i++) {
        for (int j = i + 1; j < 20; j++) {
            if (times_us[j] < times_us[i]) {
                unsigned long tmp = times_us[i]; times_us[i] = times_us[j]; times_us[j] = tmp;
            }
        }
    }
    unsigned long sum_us = 0;
    uint64_t sum_cycles = 0;
    for (int i = 0; i < 20; i++) {
        sum_us += times_us[i];
        sum_cycles += cycles_arr[i];
    }
    unsigned long median_us = (times_us[9] + times_us[10]) / 2;
    float mean_us = (float)sum_us / 20.0f;
    float mean_cycles = (float)sum_cycles / 20.0f;

    Serial.printf("  1. Incomplete V2.2 Proxy Baseline (1-Layer, 9 weights):   ~2937 us (2.937 ms) [INCOMPLETE MODEL]\n");
    Serial.printf("  2. Complete 9-Layer Legacy Unoptimized Baseline:        4528624 us (4528.624 ms)\n");
    Serial.printf("  3. Complete 9-Layer Stage-1 Loop-Inverted Engine:       1233580 us (1233.580 ms) [3.67x]\n");
    Serial.printf("  4. Complete 9-Layer Stage-2 Register-Tiled + IRAM Engine (N=20):\n");
    Serial.printf("     -> Min:    %lu us (%.3f ms)\n", times_us[0], times_us[0] / 1000.0f);
    Serial.printf("     -> Median: %lu us (%.3f ms)\n", median_us, median_us / 1000.0f);
    Serial.printf("     -> Mean:   %.1f us (%.3f ms) [~%.0f CPU cycles, %.2f cycles/MAC]\n",
                  mean_us, mean_us / 1000.0f, mean_cycles, mean_cycles / 1987584.0f);
    Serial.printf("     -> Max:    %lu us (%.3f ms)\n", times_us[19], times_us[19] / 1000.0f);
    Serial.printf("     -> Total Speedup vs Legacy 9-Layer TCN:  %.2fx faster\n", 4528624.0f / mean_us);
    Serial.printf("     -> Stage-2 Speedup vs Stage-1 Engine:    %.2fx faster\n", 1233580.0f / mean_us);
    Serial.printf("  Static Engine Memory: Weights/Scales=16,768 B | Buffers+Scratch=37,120 B | Total=53,888 B (10.1%% of 520 KB SRAM) | Free Heap=%u B\n",
                  ESP.getFreeHeap());
    Serial.println("==========================================================================");
}

static int loop_scenario_idx = 0;

void loop() {
    const int s = loop_scenario_idx % NUM_SCENARIOS;
    loop_scenario_idx++;
    const float* x_in = test_scenarios_x + s * (3 * L);

    unsigned long t0 = micros();
    run_tcn_inference_stage2(x_in);
    unsigned long infer_us = micros() - t0;

    unsigned long p0 = micros();
    float s4_mean = 0.0f, max_prob = 0.0f;
    int slip_count = 0;
    for (int t = 0; t < L; t++) {
        s4_mean += out_s4[t];
        float c_log = constrain(out_slip_logits[t], -20.0f, 20.0f);
        float prob = 1.0f / (1.0f + expf(-c_log));
        if (prob > max_prob) max_prob = prob;
        if (prob >= SLIP_PROB_THRESHOLD) slip_count++;
    }
    s4_mean /= (float)L;
    unsigned long post_us = micros() - p0;

    Serial.printf("[LIVE #%d %s] Infer: %lu us (%.3f ms) | Post: %lu us | S4: %.4f | Env[64]: %.4f | MaxProb: %.4f (Slips: %d)\n",
                  loop_scenario_idx, SCENARIO_NAMES[s], infer_us, infer_us / 1000.0f, post_us, s4_mean, out_env[64], max_prob, slip_count);
    delay(3000);
}
